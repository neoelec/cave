/dts-v1/;
/plugin/;

/{
	compatible = "brcm,bcm2835";

	fragment@0 {
		target-path = "/soc/";
		__overlay__ {
			rcn_template: raccoon,template {
				compatible = "raccoon,template";
				status = "okay";
				rcn,str = "raccoon";
				rcn,val = <1234567890>;
			};
		};
	};
};
