## 20220516/cma/Kconfig
```kconfig
config RACCOON_CMA
	tristate "Raccoon's CMA Training"
	default m
	help
	  Raccoon's CMA Training
```

## 20220517/slub/Kconfig
```kconfig
config RACCOON_SLUB
	tristate "Raccoon's SLUB Training"
	default m
	help
	  Raccoon's SLUB Training
```

## 20220521/template/Kconfig
```kconfig
config RACCOON_TEMPLATE
	tristate "Raccoon's TEMPLATE"
	default m
	help
	  Raccoon's TEMPLATE
```
